
#include <SPI.h>

#include <Wire.h>

#include <Adafruit_GFX.h>

#include <Adafruit_SSD1306.h>

  

enum EtatAffichage { AFFICHER_MENU };

  

#define SCREEN_WIDTH 128

#define SCREEN_HEIGHT 64

  

#define brocheResetOLED -1

#define adresseI2CecranOLED 0x3C

  

const int PIN_BOUTON_MILIEU = 16;

const int PIN_BOUTON_GAUCHE = 17;

const int PIN_BOUTON_DROITE = 15;

  

Adafruit_SSD1306 display(SCREEN_WIDTH, SCREEN_HEIGHT, &Wire, brocheResetOLED);

  

const unsigned char Tcosmo [] PROGMEM = {

0x00, 0xf0, 0x00, 0x0f, 0x00, 0x00, 0xf0, 0x00, 0x0f, 0x00, 0x03, 0x0f, 0xff, 0xf0, 0xc0, 0x03,

0x0f, 0xff, 0xf0, 0xc0, 0x0c, 0x00, 0x00, 0x00, 0x30, 0x0c, 0x00, 0x00, 0x00, 0x30, 0x0c, 0x00,
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0x00, 0x00, 0xff, 0x00, 0x00, 0x00, 0x00, 0xff, 0x00, 0x00

};

const unsigned char Tfood [] PROGMEM = {

0x00, 0x00, 0x03, 0xf0, 0x00, 0x00, 0x03, 0xf0, 0x00, 0x00, 0x03, 0xf0, 0x00, 0x00, 0x03, 0xf0,

0x00, 0x03, 0xc3, 0xff, 0x00, 0x03, 0xc3, 0xff, 0x00, 0x0c, 0x3f, 0xff, 0x00, 0x0c, 0x3f, 0xff,
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0x0f, 0xc0, 0x00, 0x00, 0x0f, 0xc0, 0x00, 0x00, 0x0f, 0xc0, 0x00, 0x00, 0x0f, 0xc0, 0x00, 0x00

};

const unsigned char Tplay [] PROGMEM = {

0x00, 0x03, 0xff, 0xfc, 0x00, 0x00, 0x00, 0x03, 0xff, 0xfc, 0x00, 0x00, 0x00, 0x3c, 0x00, 0x03,

0xc0, 0x00, 0x00, 0x3c, 0x00, 0x03, 0xc0, 0x00, 0x03, 0xc0, 0x00, 0x00, 0x3c, 0x00, 0x03, 0xc0,
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0x00, 0x03, 0x03, 0x00, 0x03, 0xf0, 0x00, 0x00, 0xfc, 0x00, 0x03, 0xf0, 0x00, 0x00, 0xfc, 0x00

};

const unsigned char Tsettings [] PROGMEM = {

0x00, 0x03, 0xc0, 0x00, 0x00, 0x03, 0xc0, 0x00, 0x00, 0x0f, 0xf0, 0x00, 0x00, 0x0f, 0xf0, 0x00,

0x03, 0xcf, 0xf3, 0xc0, 0x03, 0xcf, 0xf3, 0xc0, 0x0f, 0xff, 0xff, 0xf0, 0x0f, 0xff, 0xff, 0xf0,
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0x00, 0x0f, 0xf0, 0x00, 0x00, 0x0f, 0xf0, 0x00, 0x00, 0x03, 0xc0, 0x00, 0x00, 0x03, 0xc0, 0x00

};

const unsigned char Tbathroom [] PROGMEM = {

0x00, 0xf0, 0x00, 0x00, 0x00, 0x00, 0xf0, 0x00, 0x00, 0x00, 0x03, 0x0c, 0x00, 0x00, 0x00, 0x03,

0x0c, 0x00, 0x00, 0x00, 0x0c, 0x0c, 0x00, 0x00, 0x00, 0x0c, 0x0c, 0x00, 0x00, 0x00, 0x0c, 0x3f,
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0x00, 0x00, 0x30, 0x03, 0x00, 0x00

};

const unsigned char FDroite [] PROGMEM = {

0x80, 0x00, 0xe0, 0x00, 0xf8, 0x00, 0xfe, 0x00, 0xff, 0x80, 0xff, 0xe0, 0xff, 0x80, 0xfe, 0x00,

0xf8, 0x00, 0xe0, 0x00, 0x80, 0x00

};

const unsigned char FGauche [] PROGMEM = {
0x00, 0x20, 0x00, 0xe0, 0x03, 0xe0, 0x0f, 0xe0, 0x3f, 0xe0, 0xff, 0xe0, 0x3f, 0xe0, 0x0f, 0xe0,
0x03, 0xe0, 0x00, 0xe0, 0x00, 0x20};

  

const unsigned char BSalleDeJeux [] PROGMEM = {
0x00, 0x00, 0x00, 0x00, 0x00, 0x20, 0x00, 0x00, 0x00, 0x00, 0x08, 0x00, 0x00, 0x00, 0x00, 0x00, 
	0x00, 0x00, 0x00, 0x00, 0x00, 0x20, 0x00, 0x00, 0x00, 0x00, 0x08, 0x00, 0x00, 0x00, 0x00, 0x00, 
	0x00, 0x00, 0x00, 0x00, 0x00, 0x20, 0x00, 0x00, 0x00, 0x00, 0x08, 0x00, 0x00, 0x00, 0x00, 0x00, 
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	0x00, 0x00, 0x00, 0x01, 0x00, 0x00, 0x00, 0x01, 0x00, 0x00, 0x00, 0x01, 0x00, 0x00, 0x00, 0x00
};

  

bool menuAffiche = false;
bool salleDeJeuxAffiche = false; 
bool dansSalleDeJeux = false;
int selectionMenu = 0; // Indique l'élément actuellement sélectionné dans le menu
int selectionMenuJeux = 0; // Indique l'élément actuellement sélectionné dans le menu de jeux
unsigned long previousMillis = 0;
const long interval = 500; // Intervalle de clignotement en millisecondes
bool afficherTexte = true;

  
 void CosmoBienvenue() {
    display.clearDisplay();
    display.setTextSize(1);
    display.setTextColor(WHITE);
    display.setCursor(0, 2);
    display.println("Bonjour ici CosmoGone !");
    display.drawBitmap(42, 24, Tcosmo, 40, 34, WHITE);
    display.display();
}

void afficherMenuPrincipal() {
    display.clearDisplay();
    
    display.setTextSize(1);
    display.setTextColor(WHITE);
    display.setCursor(100, 2);
    display.print("Menu");

    display.drawBitmap(2, 42, FGauche, 11, 11, WHITE);
    display.drawBitmap(115, 42, FDroite, 11, 11, WHITE);

    switch (selectionMenu) {
        case 0:
            display.drawBitmap(40, 24, Tplay, 44, 32, WHITE);
            display.setCursor(0, 2);
            display.println("Jouer");
            break;
        case 1:
            display.drawBitmap(42, 24, Tfood, 32, 32, WHITE);
            display.setCursor(0, 2);
            display.println("Manger");
            break;
        case 2:
            display.drawBitmap(42, 18, Tbathroom, 34, 46, WHITE);
            display.setCursor(0, 2);
            display.println("Laver");
            break;
        case 3:
            display.drawBitmap(42, 24, Tsettings, 32, 32, WHITE);
            display.setCursor(0, 2);
            display.println("Parametres");
            break;
    }

    display.display();
}

void afficherMenuJeux() {
    display.clearDisplay();
    display.drawBitmap(1, 0, BSalleDeJeux, 128, 64, WHITE);
    display.setTextColor(WHITE);

    // Affichage des mots, avec clignotement du texte sélectionné
    unsigned long currentMillis = millis();
    if (currentMillis - previousMillis >= interval) {
        previousMillis = currentMillis;
        afficherTexte = !afficherTexte; // Inverser l'état de visibilité du texte
    }

    // Affichage de "Pong"
    display.setTextSize(1);
    display.setCursor(13, 2);
    if (selectionMenuJeux == 0 && afficherTexte) {
        display.println("Pong");
    } else if (selectionMenuJeux != 0) {
        display.println("Pong");
    }

    // Affichage de "Quizz"
    display.setCursor(52, 2);
    if (selectionMenuJeux == 1 && afficherTexte) {
        display.println("Quizz");
    } else if (selectionMenuJeux != 1) {
        display.println("Quizz");
    }

    // Affichage de "Dinosaure"
    display.setCursor(95, 2);
    if (selectionMenuJeux == 2 && afficherTexte) {
        display.println("Dinos");
    } else if (selectionMenuJeux != 2) {
        display.println("Dinos");
    }

    display.display();
}

void lancerJeu() {
    // Implémentation du lancement des jeux
    switch (selectionMenuJeux) {
        case 0:
          // Lancer le jeu Pong
            break;
        case 1:
            // Code pour lancer Quizz
            break;
        case 2:
            // Code pour lancer Dinosaure
            break;
    }
} 
  


void setup() {

pinMode(PIN_BOUTON_MILIEU, INPUT_PULLUP);

pinMode(PIN_BOUTON_GAUCHE, INPUT_PULLUP);

pinMode(PIN_BOUTON_DROITE, INPUT_PULLUP);

display.begin(SSD1306_SWITCHCAPVCC, adresseI2CecranOLED);

display.clearDisplay();

CosmoBienvenue(); // Affiche l'écran de bienvenue au démarrage

Serial.begin(9600);

}

  
void loop() {
    if (digitalRead(PIN_BOUTON_MILIEU) == LOW && !menuAffiche && !salleDeJeuxAffiche) {
        delay(250);
        menuAffiche = true;
        afficherMenuPrincipal();
    }

    if (menuAffiche) {
        if (digitalRead(PIN_BOUTON_MILIEU) == LOW) {
            selectionMenu = (selectionMenu + 1) % 4;
            afficherMenuPrincipal();
            delay(250);
        }

        if (digitalRead(PIN_BOUTON_DROITE) == LOW) {
            delay(250);
            menuAffiche = false;
            CosmoBienvenue();
        }

        if (digitalRead(PIN_BOUTON_GAUCHE) == LOW && selectionMenu == 0) {
            delay(250);
            salleDeJeuxAffiche = true;
            menuAffiche = false;
            afficherMenuJeux();
        }
    }

    if (salleDeJeuxAffiche) {
        if (digitalRead(PIN_BOUTON_MILIEU) == LOW) {
            selectionMenuJeux = (selectionMenuJeux + 1) % 3;
            afficherMenuJeux();
            delay(250);
        }

        if (digitalRead(PIN_BOUTON_DROITE) == LOW) {
            delay(250);
            salleDeJeuxAffiche = false;
            menuAffiche = true;
            afficherMenuPrincipal();
        }

        if (digitalRead(PIN_BOUTON_GAUCHE) == LOW) {
            delay(250);
            lancerJeu();
        }

        // Mettre à jour l'affichage du menu de jeux pour le clignotement
        afficherMenuJeux();
    }
}

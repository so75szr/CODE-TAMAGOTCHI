
// Calcule les coordonnées pour centrer l'image horizontalement
#define SCREEN_WIDTH 128 // (Largeur de l'écran - Largeur de l'image) / 2

// Calcule les coordonnées pour centrer l'image verticalement
#define SCREEN_HEIGHT 64 // (Hauteur de l'écran - Hauteur de l'image) / 2


#define brocheResetOLED    -1 // Broche de réinitialisation (reset) de l'écran OLED, -1 si non utilisé
#define adresseI2CecranOLED 0x3C // Adresse I2C de l'écran OLED


const int PIN_BOUTON = 16; // Pin du bouton poussoir (G12)

Adafruit_SSD1306 display(SCREEN_WIDTH, SCREEN_HEIGHT, &Wire, brocheResetOLED);
const unsigned char Tcosmo [] PROGMEM = {
	0x00, 0xf0, 0x00, 0x0f, 0x00, 0x00, 0xf0, 0x00, 0x0f, 0x00, 0x03, 0x0f, 0xff, 0xf0, 0xc0, 0x03, 
	0x0f, 0xff, 0xf0, 0xc0, 0x0c, 0x00, 0x00, 0x00, 0x30, 0x0c, 0x00, 0x00, 0x00, 0x30, 0x0c, 0x00, 
	0x00, 0x00, 0x30, 0x0c, 0x00, 0x00, 0x00, 0x30, 0x30, 0x30, 0x00, 0x0c, 0x0c, 0x30, 0x30, 0x00, 
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	0x00, 0x00, 0xff, 0x00, 0x00, 0x00, 0x00, 0xff, 0x00, 0x00
};
const unsigned char Tfood [] PROGMEM = {
	0x00, 0x00, 0x03, 0xf0, 0x00, 0x00, 0x03, 0xf0, 0x00, 0x00, 0x03, 0xf0, 0x00, 0x00, 0x03, 0xf0, 
	0x00, 0x03, 0xc3, 0xff, 0x00, 0x03, 0xc3, 0xff, 0x00, 0x0c, 0x3f, 0xff, 0x00, 0x0c, 0x3f, 0xff, 
	0x00, 0x30, 0xcf, 0xff, 0x00, 0x30, 0xcf, 0xff, 0x00, 0xc3, 0x03, 0xc0, 0x00, 0xc3, 0x03, 0xc0, 
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	0x0f, 0xc0, 0x00, 0x00, 0x0f, 0xc0, 0x00, 0x00, 0x0f, 0xc0, 0x00, 0x00, 0x0f, 0xc0, 0x00, 0x00
};
const unsigned char Tplay [] PROGMEM = {
	0x01, 0xfe, 0x00, 0x06, 0x01, 0x80, 0x18, 0x00, 0x60, 0x20, 0x78, 0x10, 0x40, 0x48, 0x08, 0x40, 
	0x78, 0x08, 0x44, 0x00, 0x88, 0x8e, 0x31, 0x44, 0x84, 0x00, 0x84, 0x80, 0xcc, 0x04, 0x80, 0x00, 
	0x04, 0x81, 0xfe, 0x04, 0x81, 0x02, 0x04, 0x42, 0x01, 0x08, 0x22, 0x01, 0x10, 0x1c, 0x00, 0xe0
};
const unsigned char Tsettingstsettings [] PROGMEM = {
	0x01, 0x80, 0x03, 0xc0, 0x1b, 0xd8, 0x3f, 0xfc, 0x3f, 0xfc, 0x1f, 0xf8, 0x7e, 0x7e, 0xfc, 0x3f, 
	0xfc, 0x3f, 0x7e, 0x7e, 0x1f, 0xf8, 0x3f, 0xfc, 0x3f, 0xfc, 0x1b, 0xd8, 0x03, 0xc0, 0x01, 0x80
};
const unsigned char FDroite [] PROGMEM = {
    0x80, 0x00, 0xe0, 0x00, 0xf8, 0x00, 0xfe, 0x00, 0xff, 0x80, 0xff, 0xe0, 0xff, 0x80, 0xfe, 0x00, 
    0xf8, 0x00, 0xe0, 0x00, 0x80, 0x00
};
const unsigned char FGauche [] PROGMEM = {
    0x00, 0x20, 0x00, 0xe0, 0x03, 0xe0, 0x0f, 0xe0, 0x3f, 0xe0, 0xff, 0xe0, 0x3f, 0xe0, 0x0f, 0xe0, 
    0x03, 0xe0, 0x00, 0xe0, 0x00, 0x20
};
enum EtatAffichage {COSMO_WELCOME, AFFICHER_MESSAGE, AFFICHER_TFOOD};
EtatAffichage etatAffichage = COSMO_WELCOME;

void setup() {
    pinMode(PIN_BOUTON, INPUT_PULLUP); // Définir le pin du bouton poussoir comme entrée avec résistance de pull-up
    display.begin(SSD1306_SWITCHCAPVCC, adresseI2CecranOLED);
    display.clearDisplay();
    Serial.begin(9600); // Initialiser la communication série à 9600 bauds
}
void cosmowelcome() {
  display.clearDisplay();
  // Calcule les coordonnées pour centrer l'image horizontalement
  int posX = (SCREEN_WIDTH - 40) / 2; // (Largeur de l'écran - Largeur de l'image) / 2

  // Calcule les coordonnées pour centrer l'image verticalement
  int posY = (SCREEN_HEIGHT - 34) / 2; // (Hauteur de l'écran - Hauteur de l'image) / 2

  // Dessine l'image centrée
  display.drawBitmap(34, 24, Tcosmo, 40, 34, WHITE);
  display.display();
}

void afficherMessage() {
  display.setTextSize(1);     
  display.setTextColor(WHITE); 
  display.setCursor(0, 2);    
  display.println("Bonjour ici CosmoGone !");
  display.display();           
};

void afficherTfood() {
    display.clearDisplay();
    display.drawBitmap(34, 24, Tfood, 32, 32, WHITE); // Afficher l'image Tfood en plein écran
    display.display();
}
void aficherFleche() {
  display.clearDisplay();
  display.drawBitmap(2, 42, gauche, 11, 11, WHITE);
  display.drawBitmap(115, 42, droite, 11, 11, WHITE);
  display.display();
}
void loop() {
    int lectureBouton = digitalRead(PIN_BOUTON); // Lire l'état du bouton
    
    if (lectureBouton == LOW) {
        // Si le bouton est enfoncé
        delay(50); // Délai pour éviter les rebonds
        if (digitalRead(PIN_BOUTON) == LOW) {
            // Vérifier si le bouton est toujours enfoncé après le délai
            if (etatAffichage == COSMO_WELCOME || etatAffichage == AFFICHER_MESSAGE) {
                etatAffichage = AFFICHER_TFOOD;
            } else {
                etatAffichage = COSMO_WELCOME;
            }
        }
        while (digitalRead(PIN_BOUTON) == LOW) {
            // Attendre que le bouton soit relâché
            delay(10);
        }
    }
    
    switch (etatAffichage) {
        case COSMO_WELCOME:
            cosmowelcome();
            afficherMessage();
            break;
        case AFFICHER_MESSAGE:
            afficherMessage();
            break;
        case AFFICHER_TFOOD:
            afficherTfood();
            break;
        default:
            break;
    }
}

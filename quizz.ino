  

#include <SPI.h>

  

#include <Wire.h>

  

#include <Adafruit_GFX.h>

  

#include <Adafruit_SSD1306.h>

  

  

enum EtatAffichage { AFFICHER_MENU };

  

  

#define SCREEN_WIDTH 128

  

#define SCREEN_HEIGHT 64

  

  

#define brocheResetOLED -1

  

#define adresseI2CecranOLED 0x3C

  

  

const int PIN_BOUTON_MILIEU = 16;

  

const int PIN_BOUTON_GAUCHE = 17;

  

const int PIN_BOUTON_DROITE = 15;

  

  

Adafruit_SSD1306 display(SCREEN_WIDTH, SCREEN_HEIGHT, &Wire, brocheResetOLED);

  

  

const unsigned char Tcosmo [] PROGMEM = {

  

0x00, 0xf0, 0x00, 0x0f, 0x00, 0x00, 0xf0, 0x00, 0x0f, 0x00, 0x03, 0x0f, 0xff, 0xf0, 0xc0, 0x03,

  
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0x00, 0x00, 0xff, 0x00, 0x00, 0x00, 0x00, 0xff, 0x00, 0x00

  

};

  

const unsigned char Tfood [] PROGMEM = {

  

0x00, 0x00, 0x03, 0xf0, 0x00, 0x00, 0x03, 0xf0, 0x00, 0x00, 0x03, 0xf0, 0x00, 0x00, 0x03, 0xf0,

  
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0x0f, 0xc0, 0x00, 0x00, 0x0f, 0xc0, 0x00, 0x00, 0x0f, 0xc0, 0x00, 0x00, 0x0f, 0xc0, 0x00, 0x00

  

};

  

const unsigned char Tplay [] PROGMEM = {

  

0x00, 0x03, 0xff, 0xfc, 0x00, 0x00, 0x00, 0x03, 0xff, 0xfc, 0x00, 0x00, 0x00, 0x3c, 0x00, 0x03,

  
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0x00, 0x03, 0x03, 0x00, 0x03, 0xf0, 0x00, 0x00, 0xfc, 0x00, 0x03, 0xf0, 0x00, 0x00, 0xfc, 0x00

  

};

  

const unsigned char Tsettings [] PROGMEM = {

  

0x00, 0x03, 0xc0, 0x00, 0x00, 0x03, 0xc0, 0x00, 0x00, 0x0f, 0xf0, 0x00, 0x00, 0x0f, 0xf0, 0x00,

  
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0x00, 0x0f, 0xf0, 0x00, 0x00, 0x0f, 0xf0, 0x00, 0x00, 0x03, 0xc0, 0x00, 0x00, 0x03, 0xc0, 0x00

  

};

  

const unsigned char Tbathroom [] PROGMEM = {

  

0x00, 0xf0, 0x00, 0x00, 0x00, 0x00, 0xf0, 0x00, 0x00, 0x00, 0x03, 0x0c, 0x00, 0x00, 0x00, 0x03,

  
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0x00, 0x00, 0x30, 0x03, 0x00, 0x00

  

};

  

const unsigned char FDroite [] PROGMEM = {

  

0x80, 0x00, 0xe0, 0x00, 0xf8, 0x00, 0xfe, 0x00, 0xff, 0x80, 0xff, 0xe0, 0xff, 0x80, 0xfe, 0x00,

  

0xf8, 0x00, 0xe0, 0x00, 0x80, 0x00

  

};

  

const unsigned char FGauche [] PROGMEM = {

0x00, 0x20, 0x00, 0xe0, 0x03, 0xe0, 0x0f, 0xe0, 0x3f, 0xe0, 0xff, 0xe0, 0x3f, 0xe0, 0x0f, 0xe0,

0x03, 0xe0, 0x00, 0xe0, 0x00, 0x20};

  

  

const unsigned char BSalleDeJeux [] PROGMEM = {

0x00, 0x00, 0x00, 0x00, 0x00, 0x20, 0x00, 0x00, 0x00, 0x00, 0x08, 0x00, 0x00, 0x00, 0x00, 0x00,

0x00, 0x00, 0x00, 0x00, 0x00, 0x20, 0x00, 0x00, 0x00, 0x00, 0x08, 0x00, 0x00, 0x00, 0x00, 0x00,
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0x00, 0x00, 0x00, 0x01, 0x00, 0x00, 0x00, 0x01, 0x00, 0x00, 0x00, 0x01, 0x00, 0x00, 0x00, 0x00

};

const unsigned char BSalleDeDouche [] PROGMEM = {

0x00, 0x00, 0x00, 0x00, 0x00, 0x20, 0x00, 0x00, 0x00, 0x00, 0x08, 0x00, 0x00, 0x00, 0x00, 0x00,

0x00, 0x00, 0x00, 0x00, 0x00, 0x20, 0x00, 0x00, 0x00, 0x00, 0x08, 0x00, 0x00, 0x00, 0x00, 0x00,
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0x00, 0x00, 0x00, 0x01, 0x00, 0x00, 0x00, 0x01, 0x00, 0x00, 0x00, 0x01, 0x00, 0x00, 0x00, 0x00

};

const unsigned char Bcuisine [] PROGMEM = {
	0x00, 0x00, 0x00, 0x00, 0x00, 0x00, 0x00, 0x01, 0x00, 0x00, 0x00, 0x00, 0x00, 0x00, 0x00, 0x00, 
	0x00, 0x00, 0x00, 0x00, 0x00, 0x00, 0x00, 0x01, 0x00, 0x00, 0x00, 0x00, 0x00, 0x00, 0x00, 0x00, 
	0x00, 0x00, 0x00, 0x00, 0x00, 0x00, 0x00, 0x01, 0x00, 0x00, 0x00, 0x00, 0x00, 0x00, 0x00, 0x00, 
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	0x00, 0x00, 0x00, 0x01, 0x00, 0x00, 0x00, 0x01, 0x00, 0x00, 0x00, 0x01, 0x00, 0x00, 0x00, 0x00
};

bool menuAffiche = false;
bool salleDeJeuxAffiche = false;
bool SalleDeDoucheAffiche = false;
bool SalleDeCuisineAffiche = false;
bool dansSalleDeJeux = false;

int selectionMenu = 0; // Indique l'élément actuellement sélectionné dans le menu
int selectionMenuJeux = 0; // Indique l'élément actuellement sélectionné dans le menu de jeux
int selectionMenuDouche = 0; // Indique l'élément actuellement sélectionné dans le menu de douche
int selectionMenuCuisine = 0; // Indique l'élément actuellement sélectionné dans le menu de cuisine

unsigned long previousMillis = 0;
const long interval = 500; // Intervalle de clignotement en millisecondes
bool afficherTexte = true;

struct Question {
    const char* question;
    const char* reponse1;
    const char* reponse2;
    int bonneReponse; // 1 pour reponse1, 2 pour reponse2
};

Question questions[80] = {
{"La capitale de la France ?", "Paris", "Londres", 1},

{"Le plus grand océan ?", "Atlantique", "Pacifique", 2},

{"Qui a peint la Joconde ?", "Vincent van Gogh", "Leonardo da Vinci", 2},

{"La tour la plus haute du monde ?", "Tour Eiffel", "Burj Khalifa", 2},

{"Le plus long fleuve du monde ?", "Nile", "Amazon", 2},

{"Quel est le plus grand désert du monde ?", "Antarctique", "Sahara", 1},

{"Quel pays est surnommé le pays du soleil levant ?", "Chine", "Japon", 2},

{"Qui a écrit 'Les Misérables' ?", "Victor Hugo", "Charles Dickens", 1},

{"Quelle est la plus grande planète du système solaire ?", "Saturne", "Jupiter", 2},

{"Quelle est la capitale de l'Australie ?", "Canberra", "Sydney", 1},

{"Qui a découvert la pénicilline ?", "Marie Curie", "Alexander Fleming", 2},

{"Lequel de ces pays fait partie de l'Amérique du Sud ?", "Argentine", "Espagne", 1},

{"Quel est le plus grand mammifère ?", "Éléphant", "Baleine bleue", 2},

{"Quelle est la langue officielle du Brésil ?", "Espagnol", "Portugais", 2},

{"En quelle année a eu lieu la Révolution française ?", "1812", "1789", 2},

{"Qui est l'auteur de 'Harry Potter' ?", "J.K. Rowling", "J.R.R. Tolkien", 1},

{"Quelle est la monnaie du Japon ?", "Yen", "Won", 1},

{"Quel est le plus grand continent ?", "Afrique", "Asie", 2},

{"Quel animal est le symbole des États-Unis ?", "Aigle", "Lion", 1},

{"Qui a inventé l'ampoule électrique ?", "Thomas Edison", "Nikola Tesla", 1},

{"Quelle est la capitale du Canada ?", "Ottawa", "Toronto", 1},

{"Quel est le plus long fleuve d'Europe ?", "Volga", "Danube", 1},

{"Quel élément chimique a pour symbole 'O' ?", "Oxygène", "Or", 1},

{"Combien de continents y a-t-il ?", "7", "6", 1},

{"Quel pays a remporté la Coupe du Monde de la FIFA 2018 ?", "France", "Croatie", 1},

{"Quel est le plus petit pays du monde ?", "Monaco", "Vatican", 2},

{"Quelle est la capitale de l'Italie ?", "Rome", "Milan", 1},

{"Quelle est la capitale de l'Allemagne ?", "Munich", "Berlin", 2},

{"Quelle est la plus grande île du monde ?", "Groenland", "Australie", 1},

{"Quel est le métal le plus précieux ?", "Or", "Platine", 1},

{"Quelle est la ville la plus peuplée du monde ?", "Tokyo", "Shanghai", 1},

{"Quelle est la capitale de la Russie ?", "Saint-Pétersbourg", "Moscou", 2},

{"Quel est le sport national du Canada ?", "Basketball", "Hockey sur glace", 2},

{"Quel est le plus grand lac d'eau douce du monde ?", "Lac Victoria", "Lac Supérieur", 2},

{"Quel pays a pour capitale Budapest ?", "Hongrie", "Roumanie", 1},

{"Qui a peint 'La Nuit étoilée' ?", "Vincent van Gogh", "Claude Monet", 1},

{"Quel est le plus grand pays du monde ?", "Russie", "Canada", 1},

{"Quelle est la capitale de l'Inde ?", "New Delhi", "Mumbai", 1},

{"Quel est le plus haut sommet du monde ?", "K2", "Everest", 2},

{"Qui a écrit 'Roméo et Juliette' ?", "Jane Austen", "William Shakespeare", 2},

{"Quel est le plus grand organe du corps humain ?", "Foie", "Peau", 2},

{"Qui a découvert l'Amérique en 1492 ?", "Ferdinand Magellan", "Christophe Colomb", 2},

{"Quelle est la plus grande ville d'Australie ?", "Melbourne", "Sydney", 2},

{"Quel est l'élément chimique avec le symbole 'H' ?", "Hydrogène", "Hélium", 1},

{"Quel est le plus long fleuve des États-Unis ?", "Missouri", "Mississippi", 1},

{"Quel pays a pour capitale Vienne ?", "Suisse", "Autriche", 2},

{"Quelle planète est la plus proche du Soleil ?", "Mercure", "Vénus", 1},

{"Quelle est la capitale de la Chine ?", "Shanghai", "Pékin", 2},

{"Quelle est la capitale du Brésil ?", "Brasília", "Rio de Janeiro", 1},

{"Quel pays est le plus peuplé du monde ?", "Chine", "Inde", 1},

{"Quel est l'élément chimique avec le symbole 'Fe' ?", "Fer", "Fluor", 1},

{"Quelle est la capitale de l'Espagne ?", "Barcelone", "Madrid", 2},

{"Quel est le plus grand océan du monde ?", "Pacifique", "Atlantique", 1},

{"Quelle est la capitale de l'Argentine ?", "Buenos Aires", "Santiago", 1},

{"Quelle est la capitale de l'Égypte ?", "Le Caire", "Alexandrie", 1},

{"Quelle est la capitale de l'Afrique du Sud ?", "Johannesburg", "Pretoria", 2},

{"Quel pays est célèbre pour ses pyramides ?", "Égypte", "Mexique", 1},

{"Quel est le plus petit continent du monde ?", "Australie", "Europe", 1},

{"Quelle est la capitale de la Grèce ?", "Athènes", "Salonique", 1},

{"Qui a écrit 'L'Odyssée' ?", "Homère", "Hésiode", 1},

{"Quel est le pays avec le plus grand nombre de langues officielles ?", "Afrique du Sud", "Inde", 1},

{"Quelle est la capitale du Portugal ?", "Lisbonne", "Porto", 1},

{"Quel pays est célèbre pour le carnaval de Rio ?", "Brésil", "Argentine", 1},

{"Quelle est la capitale de la Norvège ?", "Stockholm", "Oslo", 2},

{"Quel est le symbole chimique du potassium ?", "P", "K", 2},

{"Quelle est la capitale de la Turquie ?", "Istanbul", "Ankara", 2},

{"Quel est le plus grand océan par superficie ?", "Pacifique", "Atlantique", 1},

{"Quelle est la langue la plus parlée au monde ?", "Espagnol", "Mandarin", 2},

{"Quel est le plus petit pays par superficie ?", "Monaco", "Vatican", 2},

{"Quel est le plus grand désert chaud du monde ?", "Sahara", "Gobi", 1},

{"Quel est le plus grand archipel du monde ?", "Indonésie", "Philippines", 1},

{"Quelle est la capitale de la Suède ?", "Helsinki", "Stockholm", 2},

{"Quelle est la capitale de la Pologne ?", "Varsovie", "Cracovie", 1},

{"Quel pays a pour capitale Helsinki ?", "Finlande", "Suède", 1},

{"Quelle est la plus grande île de la Méditerranée ?", "Sicile", "Chypre", 1},

{"Qui a écrit '1984' ?", "George Orwell", "Aldous Huxley", 1}
};


int questionsSelectionnees[10];
int indiceQuestionActuelle = 0;
int score = 0;
bool quizEnCours = false;
bool questionAffichee = false;
bool enTrainDeJouerAuQuiz = false;


void gererMenu() {
    if (digitalRead(PIN_BOUTON_MILIEU) == LOW) {
        selectionMenu = (selectionMenu + 1) % 4;
        afficherMenuPrincipal();
        delay(250);
    }
    if (digitalRead(PIN_BOUTON_GAUCHE) == LOW) {
        if (selectionMenu == 0) {
            quizEnCours = true;
            demarrerQuiz();
        }
        delay(250);
    }
}

void demarrerQuiz() {

   enTrainDeJouerAuQuiz = true;
    randomSeed(millis());
    for (int i = 0; i < 10; i++) {
        questionsSelectionnees[i] = random(0, 80);
    }
    quizEnCours = true;
    indiceQuestionActuelle = 0;
    score = 0;
    afficherQuestion();
}

void afficherQuestion() {
    display.clearDisplay();
    display.setTextSize(1);
    display.setTextColor(WHITE);
    display.setCursor(0, 0);
    display.println(questions[questionsSelectionnees[indiceQuestionActuelle]].question);
    display.setCursor(0, 20);
    display.println("1. " + String(questions[questionsSelectionnees[indiceQuestionActuelle]].reponse1));
    display.setCursor(0, 30);
    display.println("2. " + String(questions[questionsSelectionnees[indiceQuestionActuelle]].reponse2));
    display.display();
    questionAffichee = true;
}

void gererQuiz() {
    if (questionAffichee) {
        if (digitalRead(PIN_BOUTON_GAUCHE) == LOW) {
            verifierReponse(1);
            questionAffichee = false;
            delay(250);
        }
        if (digitalRead(PIN_BOUTON_DROITE) == LOW) {
            verifierReponse(2);
            questionAffichee = false;
            delay(250);
        }
    } else {
        if (indiceQuestionActuelle < 9) {
            indiceQuestionActuelle++;
            afficherQuestion();
        } else {
            afficherScore();
        }
    }
}

void verifierReponse(int reponse) {
    if (reponse == questions[questionsSelectionnees[indiceQuestionActuelle]].bonneReponse) {
        score++;
        afficherResultat(true);
    } else {
        afficherResultat(false);
    }
}

void afficherResultat(bool correcte) {
    display.clearDisplay();
    display.setTextSize(2);
    display.setTextColor(WHITE);
    if (correcte) {
        display.println("Correct!");
    } else {
        display.println("Incorrect");
    }
    display.display();
    delay(4000);
}

void afficherScore() {
    display.clearDisplay();
    if (enTrainDeJouerAuQuiz) {
        // Affichage du score uniquement si le joueur est en train de jouer au quiz
        display.setTextSize(2);
        display.setTextColor(WHITE);
        display.setCursor(0, 0);
        display.print("Score: ");
        display.println(score);
        display.setTextSize(1);
        display.setCursor(0, 20);
        display.println("Rejouer ?");
        display.setCursor(0, 30);
        display.println("Gauche: Oui");
        display.setCursor(0, 40);
        display.println("Droite: Non");
        display.display();

        while (true) {
            if (digitalRead(PIN_BOUTON_GAUCHE) == LOW) {
                demarrerQuiz();
                break;
            }
            if (digitalRead(PIN_BOUTON_DROITE) == LOW) {
                quizEnCours = false;
                afficherMenuPrincipal();
                break;
            }
        }
    }
}

void CosmoBienvenue() {
    display.clearDisplay();
    display.setTextSize(1);
    display.setTextColor(WHITE);
    display.setCursor(0, 2);
    display.println("Bonjour ici CosmoGone !");
    display.drawBitmap(42, 24, Tcosmo, 40, 34, WHITE);
    display.display();
}

void afficherMenuPrincipal() {
    display.clearDisplay();
    display.setTextSize(1);
    display.setTextColor(WHITE);
    display.setCursor(100, 2);
    display.print("Menu");

    display.drawBitmap(2, 42, FGauche, 11, 11, WHITE);
    display.drawBitmap(115, 42, FDroite, 11, 11, WHITE);

    switch (selectionMenu) {
        case 0:
            display.drawBitmap(40, 24, Tplay, 44, 32, WHITE);
            display.setCursor(0, 2);
            display.println("Jouer");
            break;
        case 1:
            display.drawBitmap(42, 24, Tfood, 32, 32, WHITE);
            display.setCursor(0, 2);
            display.println("Manger");
            break;
        case 2:
            display.drawBitmap(42, 18, Tbathroom, 34, 46, WHITE);
            display.setCursor(0, 2);
            display.println("Laver");
            break;
        case 3:
            display.drawBitmap(42, 24, Tsettings, 32, 32, WHITE);
            display.setCursor(0, 2);
            display.println("Parametres");
            break;
    }

    display.display();
}

void afficherMenuJeux() {
    display.clearDisplay();
    display.drawBitmap(1, 0, BSalleDeJeux, 128, 64, WHITE);
    display.setTextColor(WHITE);

    unsigned long currentMillis = millis();
    if (currentMillis - previousMillis >= interval) {
        previousMillis = currentMillis;
        afficherTexte = !afficherTexte; // Inverser l'état de visibilité du texte
    }

    // Affichage de "Pong"
    display.setTextSize(1);
    display.setCursor(13, 2);
    if (selectionMenuJeux == 0 && afficherTexte) {
        display.println("Pong");
    } else if (selectionMenuJeux != 0) {
        display.println("Pong");
    }

    // Affichage de "Quizz"
    display.setCursor(52, 2);
    if (selectionMenuJeux == 1 && afficherTexte) {
        display.println("Quizz");
    } else if (selectionMenuJeux != 1) {
        display.println("Quizz");
    }

    // Affichage de "Dinosaure"
    display.setCursor(95, 2);
    if (selectionMenuJeux == 2 && afficherTexte) {
        display.println("Dinos");
    } else if (selectionMenuJeux != 2) {
        display.println("Dinos");
    }

    display.display();
}

void afficherMenuDouche() {
    display.clearDisplay();
    display.drawBitmap(1, 0, BSalleDeDouche, 128, 64, WHITE);
    display.setTextColor(WHITE);

    unsigned long currentMillis = millis();
    if (currentMillis - previousMillis >= interval) {
        previousMillis = currentMillis;
        afficherTexte = !afficherTexte; // Inverser l'état de visibilité du texte
    }

    // Affichage de "Brosser"
    display.setTextSize(1);
    display.setCursor(8, 2);
    if (selectionMenuDouche == 0 && afficherTexte) {
        display.println("Brush");
    } else if (selectionMenuDouche != 0) {
        display.println("Brush");
    }

    // Affichage de "Toiletter"
    display.setCursor(46, 2);
    if (selectionMenuDouche == 1 && afficherTexte) {
        display.println("Toilet");
    } else if (selectionMenuDouche != 1) {
        display.println("Toilet");
    }

    // Affichage de "Besoins"
    display.setCursor(95, 2);
    if (selectionMenuDouche == 2 && afficherTexte) {
        display.println("Needs");
    } else if (selectionMenuDouche != 2) {
        display.println("Needs");
    }

    display.display();
}

void afficherMenuCuisine() {
    display.clearDisplay();
    display.drawBitmap(1, 0, Bcuisine, 128, 64, WHITE);
    display.setTextColor(WHITE);

    // Mise à jour de l'état de clignotement du texte
    unsigned long currentMillis = millis();
    if (currentMillis - previousMillis >= interval) {
        previousMillis = currentMillis;
        afficherTexte = !afficherTexte;
    }

    display.setTextSize(1);

    // Affichage de "Drink"
    display.setCursor(32, 2);
    if (selectionMenuCuisine == 0) {
        if (afficherTexte) {
            display.println("Drink");
        } else {
            display.println("     "); // Effacer le texte pour créer l'effet de clignotement
        }
    } else {
        display.println("Drink");
    }

    // Affichage de "Eat"
    display.setCursor(96, 2);
    if (selectionMenuCuisine == 1) {
        if (afficherTexte) {
            display.println("Eat");
        } else {
            display.println("   "); // Effacer le texte pour créer l'effet de clignotement
        }
    } else {
        display.println("Eat");
    }

    display.display();
}


void lancerJeu() {
    // Implémentation du lancement des jeux
    switch (selectionMenuJeux) {
        case 0:
            // Lancer le jeu Pong
            break;
        case 1:
            // Code pour lancer Quizz
            break;
        case 2:
            // Code pour lancer Dinosaure
            break;
    }
}

void setup() {
    pinMode(PIN_BOUTON_MILIEU, INPUT_PULLUP);
    pinMode(PIN_BOUTON_GAUCHE, INPUT_PULLUP);
    pinMode(PIN_BOUTON_DROITE, INPUT_PULLUP);

    display.begin(SSD1306_SWITCHCAPVCC, adresseI2CecranOLED);
    display.clearDisplay();

    CosmoBienvenue(); // Affiche l'écran de bienvenue au démarrage

    Serial.begin(9600);
}

void loop() {
    if (digitalRead(PIN_BOUTON_MILIEU) == LOW && !menuAffiche && !salleDeJeuxAffiche && !SalleDeDoucheAffiche && !SalleDeCuisineAffiche) {
        delay(250);
        menuAffiche = true;
        afficherMenuPrincipal();
    }

    if (menuAffiche) {
        if (digitalRead(PIN_BOUTON_MILIEU) == LOW) {
            selectionMenu = (selectionMenu + 1) % 4;
            afficherMenuPrincipal();
            delay(250);
        }

        if (digitalRead(PIN_BOUTON_DROITE) == LOW) {
            delay(250);
            menuAffiche = false;
            CosmoBienvenue();
        }

        if (digitalRead(PIN_BOUTON_GAUCHE) == LOW) {
            delay(250);
            switch (selectionMenu) {
                case 0:
                    salleDeJeuxAffiche = true;
                    menuAffiche = false;
                    afficherMenuJeux();
                    break;
                case 1:
                    SalleDeCuisineAffiche = true;
                    menuAffiche = false;
                    afficherMenuCuisine();
                    break;
                case 2:
                    SalleDeDoucheAffiche = true;
                    menuAffiche = false;
                    afficherMenuDouche();
                    break;
                case 3:
                    // Logique pour le quatrième élément du menu principal
                    break;
            }
        }
    } else if (salleDeJeuxAffiche) {
        if (digitalRead(PIN_BOUTON_MILIEU) == LOW) {
            selectionMenuJeux = (selectionMenuJeux + 1) % 3;
            afficherMenuJeux();
            delay(250);
        }

        if (digitalRead(PIN_BOUTON_DROITE) == LOW) {
            delay(250);
            salleDeJeuxAffiche = false;
            menuAffiche = true;
            afficherMenuPrincipal();
        }

        if (digitalRead(PIN_BOUTON_GAUCHE) == LOW) {
            delay(250);
            // Si l'utilisateur a sélectionné "Quizz", démarrer le jeu
            if (selectionMenuJeux == 1) {
                salleDeJeuxAffiche = false;
                demarrerQuiz();
            }
        }
        afficherMenuJeux();
    } else if (SalleDeDoucheAffiche) {
        if (digitalRead(PIN_BOUTON_MILIEU) == LOW) {
            selectionMenuDouche = (selectionMenuDouche + 1) % 3;
            afficherMenuDouche();
            delay(250);
        }

        if (digitalRead(PIN_BOUTON_DROITE) == LOW) {
            delay(250);
            SalleDeDoucheAffiche = false;
            menuAffiche = true;
            afficherMenuPrincipal();
        }

        if (digitalRead(PIN_BOUTON_GAUCHE) == LOW) {
            delay(250);
            // Logique pour valider l'option de la salle de douche (ajoutez votre code ici)
        }

        afficherMenuDouche();
    } else if (SalleDeCuisineAffiche) {
        if (digitalRead(PIN_BOUTON_MILIEU) == LOW) {
            selectionMenuCuisine = (selectionMenuCuisine + 1) % 2;
            afficherMenuCuisine();
            delay(250);
        }

        if (digitalRead(PIN_BOUTON_DROITE) == LOW) {
            delay(250);
            SalleDeCuisineAffiche = false;
            menuAffiche = true;
            afficherMenuPrincipal();
        }

        if (digitalRead(PIN_BOUTON_GAUCHE) == LOW) {
            delay(250);
            // Logique pour valider l'option de la salle de cuisine (ajoutez votre code ici)
        }

        afficherMenuCuisine();
    }

    if (quizEnCours) {
        gererQuiz();
    }
}

#include <SPI.h>
#include <Wire.h>
#include <Adafruit_GFX.h>
#include <Adafruit_SSD1306.h>

#define SCREEN_WIDTH 128
#define SCREEN_HEIGHT 64

#define brocheResetOLED    -1
#define adresseI2CecranOLED 0x3C

const int PIN_BOUTON_MILIEU = 16;
const int PIN_BOUTON_GAUCHE = 17;
const int PIN_BOUTON_DROITE = 15;

Adafruit_SSD1306 display(SCREEN_WIDTH, SCREEN_HEIGHT, &Wire, brocheResetOLED);

const unsigned char Tcosmo [] PROGMEM = {
	0x00, 0xf0, 0x00, 0x0f, 0x00, 0x00, 0xf0, 0x00, 0x0f, 0x00, 0x03, 0x0f, 0xff, 0xf0, 0xc0, 0x03, 
	0x0f, 0xff, 0xf0, 0xc0, 0x0c, 0x00, 0x00, 0x00, 0x30, 0x0c, 0x00, 0x00, 0x00, 0x30, 0x0c, 0x00, 
	0x00, 0x00, 0x30, 0x0c, 0x00, 0x00, 0x00, 0x30, 0x30, 0x30, 0x00, 0x0c, 0x0c, 0x30, 0x30, 0x00, 
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	0x00, 0x00, 0xff, 0x00, 0x00, 0x00, 0x00, 0xff, 0x00, 0x00
};
const unsigned char Tfood [] PROGMEM = {
	0x00, 0x00, 0x03, 0xf0, 0x00, 0x00, 0x03, 0xf0, 0x00, 0x00, 0x03, 0xf0, 0x00, 0x00, 0x03, 0xf0, 
	0x00, 0x03, 0xc3, 0xff, 0x00, 0x03, 0xc3, 0xff, 0x00, 0x0c, 0x3f, 0xff, 0x00, 0x0c, 0x3f, 0xff, 
	0x00, 0x30, 0xcf, 0xff, 0x00, 0x30, 0xcf, 0xff, 0x00, 0xc3, 0x03, 0xc0, 0x00, 0xc3, 0x03, 0xc0, 
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	0x0f, 0xc0, 0x00, 0x00, 0x0f, 0xc0, 0x00, 0x00, 0x0f, 0xc0, 0x00, 0x00, 0x0f, 0xc0, 0x00, 0x00
};
const unsigned char Tplay [] PROGMEM = {
	0x01, 0xfe, 0x00, 0x06, 0x01, 0x80, 0x18, 0x00, 0x60, 0x20, 0x78, 0x10, 0x40, 0x48, 0x08, 0x40, 
	0x78, 0x08, 0x44, 0x00, 0x88, 0x8e, 0x31, 0x44, 0x84, 0x00, 0x84, 0x80, 0xcc, 0x04, 0x80, 0x00, 
	0x04, 0x81, 0xfe, 0x04, 0x81, 0x02, 0x04, 0x42, 0x01, 0x08, 0x22, 0x01, 0x10, 0x1c, 0x00, 0xe0
};
const unsigned char Tsettings [] PROGMEM = {
	0x01, 0x80, 0x03, 0xc0, 0x1b, 0xd8, 0x3f, 0xfc, 0x3f, 0xfc, 0x1f, 0xf8, 0x7e, 0x7e, 0xfc, 0x3f, 
	0xfc, 0x3f, 0x7e, 0x7e, 0x1f, 0xf8, 0x3f, 0xfc, 0x3f, 0xfc, 0x1b, 0xd8, 0x03, 0xc0, 0x01, 0x80
};
const unsigned char FDroite [] PROGMEM = {
    0x80, 0x00, 0xe0, 0x00, 0xf8, 0x00, 0xfe, 0x00, 0xff, 0x80, 0xff, 0xe0, 0xff, 0x80, 0xfe, 0x00, 
    0xf8, 0x00, 0xe0, 0x00, 0x80, 0x00
};
const unsigned char FGauche [] PROGMEM = {
    0x00, 0x20, 0x00, 0xe0, 0x03, 0xe0, 0x0f, 0xe0, 0x3f, 0xe0, 0xff, 0xe0, 0x3f, 0xe0, 0x0f, 0xe0, 
    0x03, 0xe0, 0x00, 0xe0, 0x00, 0x20
};

enum EtatAffichage { AFFICHER_MENU };

EtatAffichage etatAffichage = AFFICHER_MENU;
bool cosmoBienvenueAffiche = true; 
bool boutonGauchePresse = false;
bool afficherTplay = false;
bool afficherTfood = false; 

void CosmoBienvenue() {
    display.clearDisplay();
    display.setTextSize(1);     
    display.setTextColor(WHITE); 
    display.setCursor(0, 2);    
    display.println("Bonjour ici CosmoGone !");
    display.drawBitmap(34, 24, Tcosmo, 40, 34, WHITE);
    display.display();
}

void afficherMenu() {
    display.clearDisplay();
    
    // Affichez le bouton gauche et le bouton droit
    display.drawBitmap(2, 42, FGauche, 11, 11, WHITE);
    display.drawBitmap(115, 42, FDroite, 11, 11, WHITE);

    // Si l'élément "Play" est sélectionné, affichez son icône
    if (afficherTplay) {
        display.fillRect(34, 24, 32, 32, BLACK); // Efface la zone de l'icône précédente
        display.drawBitmap(34, 24, Tplay, 22, 16, WHITE);
        display.setTextSize(1);     
        display.setTextColor(WHITE); 
        display.setCursor(0, 2);    
        display.println("Jouer");
    } 
    // Si l'élément "Food" est sélectionné, affichez son icône
    else if (afficherTfood) {
        display.fillRect(34, 24, 32, 32, BLACK); // Efface la zone de l'icône précédente
        display.drawBitmap(34, 24, Tfood, 32, 32, WHITE);
        display.setTextSize(1);     
        display.setTextColor(WHITE); 
        display.setCursor(0, 2);    
        display.println("Manger");
    }

    // Affichage sur l'écran
    display.display();
}

void setup() {
    pinMode(PIN_BOUTON_MILIEU, INPUT_PULLUP);
    pinMode(PIN_BOUTON_GAUCHE, INPUT_PULLUP);
    pinMode(PIN_BOUTON_DROITE, INPUT_PULLUP);
    display.begin(SSD1306_SWITCHCAPVCC, adresseI2CecranOLED);
    display.clearDisplay();
    Serial.begin(9600);
}

void loop() {
    // Afficher CosmoBienvenue si cosmoBienvenueAffiche est vrai
    if (cosmoBienvenueAffiche) {
        CosmoBienvenue();
    }

    // Vérifiez si le bouton du milieu est pressé
    if (digitalRead(PIN_BOUTON_MILIEU) == LOW) {
        // Si oui, changez l'état de l'affichage de CosmoBienvenue pour le faire disparaître
        cosmoBienvenueAffiche = !cosmoBienvenueAffiche;
        delay(250); // Délai pour éviter la détection multiple de l'appui sur le bouton
    }

    // Afficher le menu si CosmoBienvenue n'est plus affiché
    if (!cosmoBienvenueAffiche) {
        // Vérifiez si le bouton gauche est pressé
        if (digitalRead(PIN_BOUTON_GAUCHE) == LOW) {
            // Mettez à jour l'état du menu pour afficher l'élément précédent
            afficherTplay = true;
            afficherTfood = false;
        }

        // Vérifiez si le bouton droit est pressé
        if (digitalRead(PIN_BOUTON_DROITE) == LOW) {
            // Mettez à jour l'état du menu pour afficher l'élément suivant
            afficherTfood = true;
            afficherTplay = false;
        }

        // Affichez le menu en fonction de l'état actuel
        afficherMenu();
    }

    // Ajoutez un léger délai pour éviter de lire trop rapidement les entrées des boutons
    delay(100);
}
